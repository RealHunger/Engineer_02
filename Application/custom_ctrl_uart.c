#include "custom_ctrl_uart.h"  // 对应修改后的头文件
#include "../../Bsp/led/bsp_led.h"
#include "string.h"

/******************************************************************************************
 *                                   静态全局变量（完全保留）
 ******************************************************************************************/
static uint8_t s_seq = 0;  // 包序号（0~255循环，协议表1-2要求）

/******************************************************************************************
 *                                   协议附录一 CRC16 校验表（完全保留）
 ******************************************************************************************/
static const uint16_t crc16_tab[256] = {
    0x0000, 0x1189, 0x2312, 0x329b, 0x4624, 0x57ad, 0x6536, 0x74bf,
    0x8c48, 0x9dc1, 0xaf5a, 0xbed3, 0xca6c, 0xdbe5, 0xe97e, 0xf8f7,
    0x1081, 0x0108, 0x3393, 0x221a, 0x56a5, 0x472c, 0x75b7, 0x643e,
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    0x7bc7, 0x6a4e, 0x58d5, 0x495c, 0x3de3, 0x2c6a, 0x1ef1, 0x0f78
};

/******************************************************************************************
 *                                   独立实现 CRC16 校验函数（完全保留）
 ******************************************************************************************/
static uint16_t Custom_CRC16_Check(uint8_t *p_msg, uint16_t len)
{
    uint16_t crc16 = 0xFFFF;  // CRC16初始值（协议附录一规定）
    while (len--)
    {
        uint8_t ch_data = *p_msg++;
        crc16 = (crc16 >> 8) ^ crc16_tab[(crc16 ^ ch_data) & 0x00FF];
    }
    return crc16;
}

/******************************************************************************************
 *                                   静态辅助函数：帧头CRC8计算（完全保留）
 ******************************************************************************************/
static uint8_t FrameHeader_CRC8_Calc(uint8_t *frame_header)
{
    // 官方提供的CRC8_TAB表（CRC8 MAXIM，整理规范排版，避免编译错误）
    const unsigned char CRC8_TAB[256] =
    {
        0x00, 0x5e, 0xbc, 0xe2, 0x61, 0x3f, 0xdd, 0x83, 0xc2, 0x9c, 0x7e, 0x20, 0xa3, 0xfd, 0x1f, 0x41,
        0x9d, 0xc3, 0x21, 0x7f, 0xfc, 0xa2, 0x40, 0x1e, 0x5f, 0x01, 0xe3, 0xbd, 0x3e, 0x60, 0x82, 0xdc,
        0x23, 0x7d, 0x9f, 0xc1, 0x42, 0x1c, 0xfe, 0xa0, 0xe1, 0xbf, 0x5d, 0x03, 0x80, 0xde, 0x3c, 0x62,
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        0x74, 0x2a, 0xc8, 0x96, 0x15, 0x4b, 0xa9, 0xf7, 0xb6, 0xe8, 0x0a, 0x54, 0xd7, 0x89, 0x6b, 0x35
    };

    uint8_t crc8 = 0xFF;  // CRC8初始值（官方协议要求0xFF，和表匹配）
    if (frame_header == NULL)
    {
        return 0xFF;
    }

    // 仅校验帧头前4字节（SOF + data_length + seq），符合官方协议逻辑
    for (int i = 0; i < 4; i++)
    {
        crc8 = CRC8_TAB[(crc8 ^ frame_header[i]) & 0xFF];  // 按官方表计算，确保校验值正确
    }
    return crc8;
}

/******************************************************************************************
 *                                   核心函数：UART1发送7个关节弧度 + 1个夹爪开合状态（修改发送链路）
 ******************************************************************************************/
int CustomCtrl_UART_Send_MotorData(struct uart_device *uart_dev, float joint_angles_rad[JOINT_COUNT], uint8_t gripper_open)
{
    // 1. 参数合法性校验（替换为UART设备句柄校验）
    if (uart_dev == NULL || joint_angles_rad == NULL) {
        //LED_RED_Toggle();  // 可选：参数错误指示灯
        return -1;
    }

    // 2. 初始化发送帧（39字节：frame_header(5B)+cmd_id(2B)+data(30B)+frame_tail(2B)）
    uint8_t send_frame[TOTAL_FRAME_LEN] = {0};

    /******************************************************************************************
     * 3. 填充帧头（严格遵循RoboMaster 2026协议表1-2，完全保留）
     ******************************************************************************************/
    send_frame[0] = SOF_VALUE;                                  // 第0字节：SOF固定0xA5
    send_frame[1] = (uint8_t)(DATA_LEN_MOTOR_ANGLE & 0xFF);     // 第1字节：data_length低字节（30=0x1E）
    send_frame[2] = (uint8_t)((DATA_LEN_MOTOR_ANGLE >> 8) & 0xFF); // 第2字节：data_length高字节
    send_frame[3] = s_seq++;                                   // 第3字节：包序号自增（0~255循环）
    send_frame[4] = FrameHeader_CRC8_Calc(send_frame);          // 第4字节：帧头CRC8校验

    /******************************************************************************************
     * 4. 填充命令码（0x0302，图传链路，自定义控制器→机器人，协议表1-4，完全保留）
     ******************************************************************************************/
    send_frame[5] = (uint8_t)(CUSTOM_CMD_ID & 0xFF);            // 命令码低字节（小端存储）
    send_frame[6] = (uint8_t)((CUSTOM_CMD_ID >> 8) & 0xFF);     // 命令码高字节

    /******************************************************************************************
     * 5. 填充数据段（30字节，协议要求）：7个关节float（28B）+ 夹爪bool（1B）+ 填充（1B），完全保留
     ******************************************************************************************/
    // ① 复制7个关节弧度值（float[7]，28字节，偏移7~34字节）
    memcpy(&send_frame[7], joint_angles_rad, 7 * sizeof(float));
    // ② 填充夹爪开合状态（1字节，偏移35字节：0=闭合，1=打开）
    send_frame[7 + 7*4] = gripper_open ? 0x01 : 0x00;
    // ③ 剩余1字节填充0x00（偏移36字节），凑满30字节
    send_frame[7 + 7*4 + 1] = 0x00;

    /******************************************************************************************
     * 6. 填充帧尾（CRC16整包校验，协议表1-1，校验范围：frame_header+cmd_id+data，完全保留）
     ******************************************************************************************/
    uint16_t crc16 = Custom_CRC16_Check(send_frame, FRAME_HEADER_LEN + CMD_ID_LEN + DATA_LEN_MOTOR_ANGLE);
    send_frame[TOTAL_FRAME_LEN - 2] = (uint8_t)(crc16 & 0xFF);  // CRC16低字节
    send_frame[TOTAL_FRAME_LEN - 1] = (uint8_t)((crc16 >> 8) & 0xFF); // CRC16高字节

    /******************************************************************************************
     * 7. UART1发送（替换原USB CDC发送，适配你的UART设备驱动）
     ******************************************************************************************/
    // 调用UART设备的Send函数，发送二进制帧（注意：不是Print打印字符串）
    int send_len = uart_dev->Send(uart_dev, (char *)send_frame, TOTAL_FRAME_LEN, 100);
    if (send_len != TOTAL_FRAME_LEN) {
        //LED_RED_Toggle();  // 可选：发送失败指示灯
        return -2;
    } else {
        //LED_GREEN_Toggle();// 可选：发送成功指示灯
        return 0;
    }
}

/******************************************************************************************
 *                                   初始化函数：重置包序号（完全保留）
 ******************************************************************************************/
void CustomCtrl_UART_Init(void)
{
    s_seq = 0;  // 重置包序号，上电/重启后从0开始（协议可靠性要求）
}